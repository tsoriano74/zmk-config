## boards/shields/edukey/Kconfig.defconfig
```kconfig
if SHIELD_EDUKEY_LEFT
config ZMK_KEYBOARD_NAME
    default "EduKey"

config ZMK_SPLIT_ROLE_CENTRAL
    default y
endif

if SHIELD_EDUKEY_LEFT || SHIELD_EDUKEY_RIGHT
config ZMK_SPLIT
    default y
endif
```

## config/boards/shields/edukey/Kconfig.shield
```kconfig
config SHIELD_EDUKEY_LEFT
    def_bool $(shields_list_contains,edukey_left)

config SHIELD_EDUKEY_RIGHT
    def_bool $(shields_list_contains,edukey_right)
```
